## examples/zephyr-custom-board/zephyr/boards/arm/my_custom_board/Kconfig.board
```kconfig
# LPCXpresso55S16 board

# Copyright (c) 2020 Henrik Brix Andersen <henrik@brixandersen.dk>
# SPDX-License-Identifier: Apache-2.0

config BOARD_MY_CUSTOM_BOARD
	bool "BOARD BASED ON LPC55S16"
	depends on SOC_SERIES_LPC55XXX
	select SOC_PART_NUMBER_LPC55S16JBD100
```
